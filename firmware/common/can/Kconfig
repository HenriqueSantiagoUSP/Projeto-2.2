## firmware/common/can/Kconfig
```kconfig
menu "CAN bus (TWAI)"

    config APP_CAN_SELF_TEST
        bool "Bench mode (self test + loopback)"
        default y
        help
            The node needs no ACK and receives its own frames back, so it works with no
            other node on the bus. It still needs its transceiver: on the ESP32-S3 the
            frame comes back through the RX pin, read from the bus, not by an internal
            route. Without a transceiver nothing comes back and "CAN bus not connected"
            is reported once. Turn it off on the real bus, where another node provides
            the ACK.

endmenu
```

## firmware/common/mqtt_link/Kconfig
```kconfig
menu "MQTT"

    config APP_MQTT_URI
        string "Broker URI"
        default "mqtt://192.168.0.10:1883"
        help
            Address of the central's Mosquitto. Use mqtts://...:8883 when TLS is set up.

    config APP_MQTT_USERNAME
        string "Broker username"
        default "hub"
        help
            "hub" for a room hub, "vestivel" for a wearable (interface/mosquitto/acl):
            each user may only publish its own topics.

    config APP_MQTT_PASSWORD
        string "Broker password"
        default ""
        help
            Lives only in sdkconfig, which git ignores. Must match the user's password
            in interface/.env.

    config APP_SITE
        string "Site (institution) in the topic"
        default "butanta"
        help
            Topics are idoso/<site>/<room>/... (docs/protocolo.md).

    config APP_ROOM
        string "Room in the topic"
        default "quarto101"

    config APP_MQTT_OUTBOX_KB
        int "Outbox limit while offline, in KiB"
        range 4 256
        default 32
        help
            QoS 1 messages queued while the broker is unreachable are kept up to this
            size and sent on reconnection.

endmenu
```

## firmware/common/net/Kconfig
```kconfig
menu "Network (Wi-Fi)"

    config APP_WIFI_SSID
        string "Wi-Fi SSID"
        default ""
        help
            Network of the central (the Raspberry Pi access point or the institution's
            Wi-Fi). Empty: the board does not join any network and only uses the radio
            for ESP-NOW (the hub stays on APP_WIFI_CHANNEL_NO_AP), for bench tests
            without a router.

    config APP_WIFI_PASSWORD
        string "Wi-Fi password"
        default ""

    config APP_WIFI_CHANNEL_NO_AP
        int "Radio channel of the hub when no SSID is configured"
        range 1 13
        default 1

    config APP_SNTP_SERVER
        string "SNTP server"
        default "pool.ntp.org"
        help
            Use the central's address to run without internet (an NTP server on the
            Raspberry Pi).

    config APP_TIMEZONE
        string "POSIX TZ of the institution"
        default "<-03>3"
        help
            Local time for the night window of the rules. "<-03>3" is Brasilia time
            (UTC-3, no daylight saving).

endmenu
```

## firmware/common/pcb/Kconfig
```kconfig
menu "PCB"

    config PCB_DEVKIT_V1_1
        bool "ESP32-S3-DevKitC-1 v1.1 (RGB LED on GPIO38 instead of GPIO48)"
        default n
        help
            The status LED is the DevKit's own WS2812: GPIO48 on board v1.0, GPIO38 on
            v1.1. The version is printed on the DevKit.

endmenu
```

## firmware/gadget/main/Kconfig.projbuild
```kconfig
menu "Wearable"

    config GADGET_HUB_MAC
        string "MAC of the room hub"
        default ""
        help
            "aa:bb:cc:dd:ee:ff", the station MAC the hub prints at boot. Empty: no
            hub (a bench or a demo with this board only). ESP-NOW is then not
            started, and falls go to the serial log (and to MQTT and CAN when they
            are on). See sdkconfig.demo.defaults. A value of the wrong length fails
            the build.

    config GADGET_ESPNOW_ENCRYPT
        bool "Encrypt ESP-NOW (PMK + LMK)"
        default y
        help
            Must match the hub: same PMK, and this wearable's MAC configured there.

    config GADGET_ESPNOW_PMK
        string "Primary master key (16 characters)"
        default "pmk-change-me-16"
        help
            Exactly 16 characters, the same on the hub; another length fails the build.

    config GADGET_ESPNOW_LMK
        string "Local master key (16 characters)"
        default "lmk-change-me-16"
        help
            Exactly 16 characters, the same on the hub; another length fails the build.

    config GADGET_FALL_TRIGGER_CG
        int "Fall trigger: peak of filtered |a| (L_on), in hundredths of g"
        range 120 800
        default 200
        help
            A peak of |a| (20 Hz low-pass) at or above this wakes the classifier
            (200 = 2.0 g). The trigger decides nothing: running or sitting down hard
            cross it too, and the classifier tells them from a fall. 2.0 g is what
            the models were trained with (SisFall at +-8 g: 99.2 % of the falls cross
            it); changing it moves the windows away from the training data. Revisit
            it with the wrist data (modelo/experimentos/02_gatilho.py), then retrain.

    choice GADGET_FALL_CLASSIFIER
        prompt "Fall classifier"
        default GADGET_FALL_CLASSIFIER_RF
        help
            Both come from modelo/experimentos/09_exportar_vestivel.py (SisFall,
            waist, +-8 g) and run on the same 23 features. They are provisional
            until retrained with the wrist data (docs/pendencias.md).

        config GADGET_FALL_CLASSIFIER_RF
            bool "Random forest (60 trees): the chosen model"

        config GADGET_FALL_CLASSIFIER_LR
            bool "Logistic regression (23 weights)"
    endchoice

    config GADGET_FALL_COOLDOWN_S
        int "Seconds after a reported fall before another one is reported"
        range 1 600
        default 30

    config GADGET_CANCEL_WINDOW_S
        int "Seconds the resident has to cancel a fall with the button"
        range 0 120
        default 15

    config GADGET_BUTTON_SIMULATES_FALL
        bool "Button simulates a fall when none is pending (tests only)"
        default n
        help
            Exercises the whole path wearable -> hub -> central -> Telegram without
            having to fall. Leave off in use.

    config GADGET_COLLECT_MODE
        bool "Data collection mode: print every raw sample as CSV"
        default n
        help
            Prints "CSV:t_ms,ax,ay,az,gx,gy,gz" in raw counts at 200 Hz, for building
            the dataset of the fall model (docs/coleta-de-dados.md), and a "FEAT:"
            line per trigger with its 23 features, P(fall) and the CPU cycles.

    config GADGET_BATTERY_SENSE
        bool "Battery voltage divider fitted"
        default n
        help
            The single prototype PCB has no divider: the wearable runs from a power bank
            on the board's USB-C input, and heartbeats report the battery as unknown
            (0xFFFF), so the hub skips the low-battery rule. Turn it on for a board with
            a LiPo and a divider on PIN_BATTERY.

    config GADGET_BATTERY_DIVIDER_X1000
        int "Divider ratio (battery / pin voltage) x 1000"
        depends on GADGET_BATTERY_SENSE
        range 1000 10000
        default 2000

    config GADGET_MQTT
        bool "Also join the Wi-Fi and talk to the central over MQTT"
        default n
        help
            The wearable joins APP_WIFI_SSID (menu "Network (Wi-Fi)") and the broker
            (menu "MQTT", user "vestivel"). ESP-NOW to the hub stays the main path and
            then rides on the access point's channel. Over MQTT the wearable publishes
            its own telemetry and, when the hub does not acknowledge a fall even after
            looking for it, publishes the fall alert itself (docs/protocolo.md §1).
            Costs battery: the radio stays associated.

    config GADGET_CAN
        bool "CAN bus (bench tests and course requirement only)"
        default n
        help
            Sends falls and heartbeats as CAN frames 0x0FD / 0x0FE (docs/protocolo.md
            §2) through a transceiver on PIN_CAN_TX / PIN_CAN_RX, and logs what the
            other nodes send. Not part of the product: the wearable has no transceiver.

endmenu
```

## firmware/room/components/espnow_link/Kconfig
```kconfig
menu "Room hub: ESP-NOW"

    config HUB_WEARABLE_MAC
        string "MAC of the paired wearable"
        default ""
        help
            "aa:bb:cc:dd:ee:ff". The hub expects it from boot, so silence counts as
            offline, registers it as an encrypted peer and ignores frames from any
            other sender. Empty: accept any wearable, unencrypted (bench only). A
            value of the wrong length fails the build.

    config HUB_ESPNOW_ENCRYPT
        bool "Encrypt ESP-NOW (PMK + LMK)"
        default y
        help
            Needs HUB_WEARABLE_MAC. Both sides must use the same keys.

    config HUB_ESPNOW_PMK
        string "Primary master key (16 characters)"
        default "pmk-change-me-16"
        help
            Exactly 16 characters, the same on the wearable; another length fails the build.

    config HUB_ESPNOW_LMK
        string "Local master key of the wearable (16 characters)"
        default "lmk-change-me-16"
        help
            Exactly 16 characters, the same on the wearable; another length fails the build.

endmenu
```

## firmware/room/components/sensors/Kconfig
```kconfig
menu "Room hub: sensors"

    config HUB_PIR_FITTED
        bool "HC-SR501 presence sensor (PIR) fitted"
        default y
        help
            Off: the presence input is not read, published nor sent on CAN, and the
            rules built on presence (inactivity, night exit) are suspended. An
            unplugged PIR reads as "nobody here", which would raise a false
            inactivity alert by day.

    config HUB_LM35_FITTED
        bool "LM35 temperature sensor fitted"
        default y
        help
            Off: no temperature is read, published nor sent on CAN, and the
            temperature rule never fires. A fitted LM35 that comes loose is caught
            anyway: readings outside 0-57 degC are dropped, with one warning.

    config HUB_DOORS_ABSENT
        string "Doors not fitted (ids of BOARD_DOORS, comma separated)"
        default ""
        help
            For example "banheiro" or "quarto,banheiro". An unplugged reed switch
            reads as "open", which would raise false night exit alerts. A door
            listed here is not read, published nor sent on CAN, and the rules never
            see it move. The other doors keep their indexes and CAN ids.

endmenu
```
